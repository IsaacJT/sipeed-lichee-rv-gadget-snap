/dts-v1/;
/plugin/;

/ {
	fragment@0 {
		target = <&gpio>;
		__overlay__ {
			uart2_pb_pins: uart2-pb-pins {
				pins = "PD1", "PD2";
				function = "uart2";
			};
		};
	};

	fragment@1 {
		target = <&uart2>;
		__overlay__ {
			pinctrl-0 = <&uart2_pb_pins>;
			pinctrl-names = "default";
			status = "okay";
		};
	};
};
